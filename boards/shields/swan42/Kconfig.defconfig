## boards/shields/swan42/Kconfig.defconfig
```kconfig
if SHIELD_SWAN42_LEFT

config ZMK_KEYBOARD_NAME
    default "swan42"

endif

if SHIELD_SWAN42_LEFT || SHIELD_SWAN42_RIGHT

config ZMK_SPLIT
    default y

endif
```

## boards/shields/swan42/Kconfig.shield
```kconfig
config SHIELD_SWAN42_LEFT
    def_bool $(shields_list_contains,swan42_left)
config SHIELD_SWAN42_RIGHT
    def_bool $(shields_list_contains,swan42_right)
```
